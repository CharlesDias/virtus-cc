#include <zephyr/dt-bindings/input/input-event-codes.h>

/ {
	aliases {
		led0 = &led0;
	};

	leds {
		compatible = "gpio-leds";
		led0: led0 {
			label = "LED0";
			gpios = <&gpio0 8 GPIO_ACTIVE_HIGH>;
		};
	};
};
