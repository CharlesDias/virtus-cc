## CMakeLists.txt
```
# SPDX-License-Identifier: Apache-2.0

cmake_minimum_required(VERSION 3.20.0)

find_package(Zephyr)
project(lab2_kconfig)

target_sources(app PRIVATE src/main.c)
```

## Kconfig
```
menu "Example Configuration"

config EXAMPLE_BOOL
    bool "Example boolean variable"
    default n
    help
      This is an example boolean variable. It can be enabled or disabled.

config EXAMPLE_INT
    int "Example integer variable"
    default 50
    range 0 100
    help
      This is an example integer variable with a default value of 42.
      It can be set to any value between 0 and 100.

endmenu

source "Kconfig.zephyr"
```

## prj.conf
```kconfig
CONFIG_EXAMPLE_BOOL=y
CONFIG_EXAMPLE_INT=42
```

## boards/native_sim.conf
```kconfig
CONFIG_EXAMPLE_BOOL=y
CONFIG_EXAMPLE_INT=30
```

## src/main.c
```c
/*
 * Copyright (c) 2024 Charles Dias, VIRTUS/UFCG
 *
 * SPDX-License-Identifier: Apache-2.0
 */

#include <zephyr/kernel.h>
#include <zephyr/sys/printk.h>

int main(void)
{
    #ifdef CONFIG_EXAMPLE_BOOL
        printk("Example boolean variable is enabled.\n");
    #else
        printk("Example boolean variable is disabled.\n");
    #endif

    printk("Example integer variable value: %d\n", CONFIG_EXAMPLE_INT);

	return 0;
}
```
